## app/boards/shields/btrfld/Kconfig.defconfig
```kconfig
# Copyright (c) 2021 The ZMK Contributors
# SPDX-License-Identifier: MIT

if SHIELD_BTRFLD

config ZMK_KEYBOARD_NAME
    default "btrfld"

config ZMK_BACKLIGHT
    select LED
    select LED_GPIO
    select PWM
    select LED_PWM

endif
```

## app/dts/bindings/behaviors/zmk,behavior-midi-key-press.yaml
```yaml
description: Midi key press/release behavior

compatible: "zmk,behavior-midi-key-press"

include: one_param.yaml
```
